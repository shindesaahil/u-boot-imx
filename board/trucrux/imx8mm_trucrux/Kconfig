## board/trucrux/imx8mm_trucrux/Kconfig
```kconfig
if TARGET_IMX8MM_TRUCRUX

config SYS_BOARD
	default "imx8mm_trucrux"

config SYS_VENDOR
	default "trucrux"

config SYS_CONFIG_NAME
	default "imx8mm_trucrux"

source "board/freescale/common/Kconfig"
source "board/trucrux/common/Kconfig"

endif
```

## board/trucrux/imx8mq_trucrux/Kconfig
```kconfig
if TARGET_IMX8MQ_TRUCRUX

config SYS_BOARD
	default "imx8mq_trucrux"

config SYS_VENDOR
	default "trucrux"

config SYS_CONFIG_NAME
	default "imx8mq_trucrux"

source "board/freescale/common/Kconfig"

endif
```

## board/trucrux/imx93_trucrux/Kconfig
```kconfig
if TARGET_IMX93_TRUCRUX

config SYS_BOARD
        default "imx93_trucrux"

config SYS_VENDOR
        default "trucrux"

config SYS_CONFIG_NAME
        default "imx93_trucrux"

source "board/freescale/common/Kconfig"
source "board/trucrux/common/Kconfig"

endif     
```
